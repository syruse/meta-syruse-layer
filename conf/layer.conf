## conf/layer.conf
```bitbake
# We have a conf and classes directory, add to BBPATH
BBPATH .= ":${LAYERDIR}"

# We have recipes-* directories, add to BBFILES
BBFILES += "${LAYERDIR}/recipes*/*/*.bb \
            ${LAYERDIR}/recipes*/*/*.bbappend"

BBFILE_COLLECTIONS += "meta-syruse-layer"
BBFILE_PATTERN_meta-syruse-layer = "^${LAYERDIR}/"
BBFILE_PRIORITY_meta-syruse-layer = "10"

LAYERDEPENDS_meta-syruse-layer = "core"
LAYERSERIES_COMPAT_meta-syruse-layer = "langdale dunfell kirkstone hardknott"

DISTRO_FEATURES:append = " opengl egl wayland "
DISTRO_FEATURES:remove = "x11"
DISTRO_FEATURES:remove = "ptest"
DISTRO_FEATURES:append = " systemd "
CORE_IMAGE_EXTRA_INSTALL += "wayland weston"
#disable undesired init manager "sysvinit"
DISTRO_FEATURES_BACKFILL_CONSIDERED += "sysvinit"
INIT_MANAGER = "systemd"
```
